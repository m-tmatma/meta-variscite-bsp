## conf/machine/imx6ul-var-dart.conf
```bitbake
#@TYPE: Machine
#@NAME: Variscite DART-6UL
#@SOC: i.MX6UL
#@DESCRIPTION: Machine configuration for Variscite DART-6UL
#@MAINTAINER: Eran Matityahu <eran.m@variscite.com>
#
# http://www.variscite.com

MACHINEOVERRIDES =. "mx6ul:"
require conf/machine/include/imx-base.inc
require conf/machine/include/arm/armv7a/tune-cortexa7.inc

require variscite.inc
require variscite_bcm43xx.inc
require variscite_ubi.inc

# Variscite BSP default providers
PREFERRED_PROVIDER_virtual/kernel:imx6ul-var-dart ?= "linux-variscite"
PREFERRED_PROVIDER_u-boot:imx6ul-var-dart ?= "u-boot-variscite"
PREFERRED_PROVIDER_u-boot-fw-utils:imx6ul-var-dart ?= "u-boot-fw-utils"
PREFERRED_PROVIDER_virtual/bootloader:imx6ul-var-dart ?= "u-boot-variscite"

SERIAL_CONSOLES = "115200;ttymxc0"


KERNEL_IMAGETYPE = "zImage"

KERNEL_DEVICETREE = " \
		     imx6ull-var-dart-6ulcustomboard-emmc-sd-card.dtb \
		     imx6ull-var-dart-6ulcustomboard-emmc-wifi.dtb \
		     imx6ull-var-dart-6ulcustomboard-nand-sd-card.dtb \
		     imx6ull-var-dart-6ulcustomboard-nand-wifi.dtb \
		     imx6ull-var-som-concerto-board-emmc-sd-card.dtb \
		     imx6ull-var-som-concerto-board-nand-wifi.dtb \
		     imx6ull-var-som-concerto-board-emmc-wifi.dtb \
		     imx6ull-var-som-concerto-board-nand-sd-card.dtb \
		     imx6ull-9x9-evk-btwifi.dtb \
		     imx6ull-9x9-evk-btwifi-oob.dtb \
		     imx6ull-9x9-evk-ldo.dtb \
		     imx6ull-9x9-evk.dtb \
		     imx6ull-14x14-evk-gpmi-weim.dtb \
		     imx6ull-14x14-ddr3-arm2-ecspi.dtb \
		     imx6ull-14x14-ddr3-arm2-uart2.dtb \
		     imx6ull-14x14-evk-usb-certi.dtb \
		     imx6ull-14x14-ddr3-arm2-gpmi-weim.dtb \
		     imx6ull-14x14-ddr3-arm2-lcdif.dtb \
		     imx6ull-14x14-ddr3-arm2-usb.dtb \
		     imx6ull-14x14-evk-emmc.dtb \
		     imx6ull-14x14-ddr3-arm2-tsc.dtb \
		     imx6ull-14x14-ddr3-arm2-ldo.dtb \
		     imx6ull-14x14-ddr3-arm2-flexcan2.dtb \
		     imx6ull-14x14-evk-btwifi-oob.dtb \
		     imx6ull-14x14-ddr3-arm2-adc.dtb \
		     imx6ull-14x14-ddr3-arm2.dtb \
		     imx6ull-14x14-ddr3-arm2-epdc.dtb \
		     imx6ull-14x14-ddr3-arm2-wm8958.dtb \
		     imx6ull-14x14-ddr3-arm2-qspi.dtb \
		     imx6ull-14x14-ddr3-arm2-emmc.dtb \
		     imx6ull-14x14-evk-btwifi.dtb \
		     imx6ull-14x14-evk.dtb \
		     imx6ull-14x14-ddr3-arm2-qspi-all.dtb \
		     imx6ull-14x14-ddr3-arm2-cs42888.dtb \
		     "

SOC_DEFAULT_WKS_FILE = "imx-uboot-spl-bootpart.wks.in"

IMAGE_BOOT_FILES = " \
    ${KERNEL_IMAGETYPE} \
    ${KERNEL_DEVICETREE} \
	"

UBOOT_MAKE_TARGET = ""
SPL_BINARY = "SPL"
UBOOT_SUFFIX = "img"
UBOOT_CONFIG ??= "nand sd "
# The above order matters. The last one will be also called u-boot-${MACHINE} and will be used to create the sdcard.
UBOOT_CONFIG[sd] = "mx6ul_var_dart_mmc_defconfig,sdcard"
UBOOT_CONFIG[nand] = "mx6ul_var_dart_nand_defconfig,ubifs"

MACHINE_FIRMWARE:append = " linux-firmware-imx-sdma-imx6q"
```

## conf/machine/variscite-mirrors.inc
```bitbake
MIRRORS += "\
    git://anonscm.debian.org/.*   git://anonscm.debian.org/git/PATH;protocol=https \n \
    git://git.gnome.org/.*        git://git.gnome.org/browse/PATH;protocol=https \n \
    git://git.savannah.gnu.org/.* git://git.savannah.gnu.org/git/PATH;protocol=https \n \
    git://git.yoctoproject.org/.* git://git.yoctoproject.org/git/PATH;protocol=https \n \
    git://.*/.*                   git://HOST/PATH;protocol=https \n \
    git://source.codeaurora.org/external/imx/ git://github.com/nxp-imx/ \n \
    https://source.codeaurora.org/external/imx/ https://github.com/nxp-imx/ \n \
    http://source.codeaurora.org/external/imx/ http://github.com/nxp-imx/ \n \
    gitsm://source.codeaurora.org/external/imx/ gitsm://github.com/nxp-imx/ \n \
"

# Force nobranch to fix renamed default branches
INHERIT += "srcuri-force-nobranch"

SRCURI_FORCE_NOBRANCH_LIST ??= " \
    vulkan-loader git://github.com/KhronosGroup/Vulkan-Loader \n \
    glslang git://github.com/KhronosGroup/glslang \n \
    tesseract-lang git://github.com/tesseract-ocr/tessdata \n \
"
```
